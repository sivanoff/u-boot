// SPDX-License-Identifier: (GPL-2.0+ OR MIT)
/*
 * Copyright (c) 2019 BayLibre, SAS
 * Author: flippy <flippy@sina.com>
 */
/dts-v1/;

#include "meson-sm1-x96-max-plus.dts"

&external_phy  {
	max-speed = <100>;
};
